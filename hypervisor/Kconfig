## hypervisor/Kconfig
```kconfig
mainmenu "ACRN Configuration"

source "arch/x86/Kconfig"
source "common/Kconfig"
```

## hypervisor/common/Kconfig
```kconfig
menu "Common"
config SOFTIRQ
	bool "Enable softirq"
	default y
	help
	  Enable/disable softirq support.
endmenu #Common
```
